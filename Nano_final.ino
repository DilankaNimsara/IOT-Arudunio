#include <ArduinoJson.h>
#include "SSD1306Ascii.h"
#include "SSD1306AsciiAvrI2c.h"
#include <TinyGPS++.h>
#include <SoftwareSerial.h>
#include <TimeLib.h>   
#define ARDUINO_GPS_RX 4
#define ARDUINO_GPS_TX 3
#define GPS_BAUD 9600
#define gpsPort ssGPS
#define SerialMonitor Serial
#define I2C_ADDRESS 0x3C
////
String responseString;
unsigned long previous=0;
unsigned long beltTime;
static long maxResponseTime = 3000;// Maximum time to wait SIM module for response
static const unsigned long frequency = 30000;// How frequently we want to send the location (milliseconds)
//////
TinyGPSPlus tinyGPS;
SoftwareSerial ssGPS(ARDUINO_GPS_RX,ARDUINO_GPS_TX );
SSD1306AsciiAvrI2c oled;
SoftwareSerial mySIM(9, 10); 

const unsigned char logo [] PROGMEM = { // Draw mode: vertical - 1 bit per pixel
 0xff, 0xff, 0xff, 0xff, 0xff, 0xff, 0xff, 0xff, 0xff, 0xff, 0xff, 0xff, 0xff, 0xff, 0xff, 0xff, 
 0xff, 0xff, 0xff, 0xff, 0xff, 0xff, 0xff, 0x7f, 0xff, 0x7f, 0xbf, 0xbf, 0xdf, 0xdf, 0xff, 0xff, 
  0xff, 0xff, 0xef, 0xef, 0xf7, 0xf7, 0xdf, 0x9b, 0x1b, 0x13, 0x13, 0x17, 0x07, 0x07, 0x07, 0x07, 
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  0xff, 0xff, 0xff, 0xff, 0xff, 0xff, 0xff, 0xff, 0xff, 0xff, 0xff, 0xff, 0xff, 0xff, 0xff, 0xff
};

const unsigned char alert [] PROGMEM = {
0x00, 0x00, 0x00, 0x00, 0x00, 0x00, 0x00, 0x00, 0x00, 0x00, 0x00, 0x00, 0x00, 0x00, 0x00, 0x00, 
  0x00, 0x00, 0x00, 0x00, 0x00, 0x00, 0x00, 0x00, 0x00, 0x00, 0x00, 0x00, 0x00, 0x00, 0x00, 0x00, 
  0x00, 0x00, 0x00, 0x00, 0x00, 0x00, 0x00, 0x00, 0x00, 0x00, 0x00, 0x00, 0x00, 0x00, 0x00, 0x00, 
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  0x00, 0x00, 0x00, 0x00, 0x00, 0x00, 0x00, 0x00, 0x00, 0x00, 0x00, 0x00, 0x00, 0x00, 0x00, 0x00
};

const unsigned char delayed [] PROGMEM = {
  0xff, 0xff, 0xff, 0xff, 0xff, 0xff, 0xff, 0xff, 0xff, 0xff, 0xff, 0xff, 0xff, 0xff, 0xff, 0xff, 
  0xff, 0xff, 0xff, 0xff, 0xff, 0xff, 0xff, 0xff, 0xff, 0xff, 0xff, 0xff, 0xff, 0xff, 0xff, 0xff, 
  0xff, 0xff, 0xff, 0xff, 0xff, 0xff, 0xff, 0xff, 0xff, 0xff, 0xff, 0xff, 0xff, 0xff, 0xff, 0xff, 
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  0xff, 0xff, 0xff, 0xff, 0xff, 0xff, 0xff, 0xff, 0xff, 0xff, 0xff, 0xff, 0xff, 0xff, 0xff, 0xff
};

void setup()
{
   
  pinMode(6,INPUT);
  pinMode(7,INPUT);
  SerialMonitor.begin(9600);
  mySIM.begin(9600);
  gpsPort.begin(GPS_BAUD);
  mySIM.listen();
  oled.begin(&Adafruit128x64, I2C_ADDRESS);
  displaylogo(logo);
  delay(15000);
  oled.setFont(System5x7);
  oled.clear();
  mySIM.println("AT+SAPBR=3,1,\"CONTYPE\",\"GPRS\"");
  delay(1000);
   printSerialData("Bringing up GPRS service");
  mySIM.println("AT+CSTT=\"ppwap\",\"\",\"\"");
 delay(1000);
  mySIM.println("AT+SAPBR=3,1,\"APN\",\"ppwap\"");
 delay(1000);
  printSerialData("Setting up the Apn ");
  mySIM.println("AT+SAPBR=3,1,\"USER\",\"\"");
 delay(1000);
  printSerialData("Setting up the User");
  mySIM.println("AT+SAPBR=3,1,\"PWD\",\"\"");
 delay(1000);
  printSerialData("Setting up the Password");
//////
  mySIM.println("AT+SAPBR=1,1");
   delay(1000);
  printSerialData("Enabling the GPRS");
  SerialMonitor.println("AT+SAPBR=2,1");
// waitUntilResponse("OK");
  printSerialData("Ip Chekced");
  mySIM.println("AT+HTTPINIT");
  delay(500);
  printSerialData("HTTP Session Start");
   mySIM.println("AT+HTTPPARA=\"URL\",\"us-central1-iotd-e0586.cloudfunctions.net/webApi/api/v1/sensor/qGv68kH8FuLxqHK7RaKP\"");
   delay(500);
  printSerialData("Url Set");
  mySIM.println("AT+HTTPPARA=\"CONTENT\",\"application/json\"");
  printSerialData("Url Set");
   gpsPort.listen();
  oled.clear();
  previous = millis();
  
}

void loop(){

  int button=digitalRead(7);
  int button2=digitalRead(6);
 if(button==HIGH){
   oled.clear();
   delay(1000);
   displaylogo(alert);
  char json[]="{\"Emergency\":1}";
   mySIM.listen();
   mySIM.println("AT+HTTPINIT");
   delay(1000);
  mySIM.println("AT+HTTPDATA=16,3000");
  delay(1000);
  mySIM.println(json);
  waitUntilResponse("OK");
  mySIM.println("AT+HTTPACTION=1");
   delay(1000);
  mySIM.println("AT+HTTPTERM");
  delay(1000);
    exit(1);
  }

 if(button2==HIGH){
   oled.clear();
   delay(1000);
   displaylogo(delayed);
   char json[]="{\"Delay\":1}";
   SerialMonitor.println(json);
   mySIM.listen();
   mySIM.println("AT+HTTPINIT");
   delay(1000);
  mySIM.println("AT+HTTPDATA=12,3000");
  delay(1000);
  mySIM.println(json);
  waitUntilResponse("OK");
  mySIM.println("AT+HTTPACTION=1");
   delay(1000);
  mySIM.println("AT+HTTPTERM");
  delay(1000);
    exit(1);
  }



   if(millis() - previous > frequency)
  { 

    previous = millis();
    SerialMonitor.println("Eveyr 1 miniute");

     StaticJsonDocument<60> jsonBuffer;
//  JsonObject& object = jsonBuffer.createObject();
  double lats=double(tinyGPS.location.lat());
   double longs=double(tinyGPS.location.lng());
    mySIM.listen();
  jsonBuffer["Lat"]= lats;
  jsonBuffer["Long"]= longs;
   String times=String(hour())+":"+String(minute())+":"+String(second());
// times+="\n";;
 jsonBuffer["Time"]= times;
  jsonBuffer["Speed"]= tinyGPS.speed.kmph();

  serializeJson(jsonBuffer, SerialMonitor);
  Serial.println(" ");  
 char buffers[100];
 serializeJson(jsonBuffer, buffers);
  SerialMonitor.println(buffers);
  mySIM.listen();
  mySIM.println("AT+HTTPINIT");
  delay(1000); 
  mySIM.println("AT+HTTPDATA=100,4000");
  delay(1000);
  mySIM.println(buffers);
  waitUntilResponse("OK");
  mySIM.println("AT+HTTPACTION=1");
  delay(1000);
  mySIM.println("AT+HTTPTERM");
//  jsonBuffer.clear();
   delay(1000);
  gpsPort.listen();
   
  }
   Serial.println(30 - int((millis() - previous)/1000.0));
  printGPSInfo();
  smartDelay(1000);
  oled.setCursor(0, 0);
  }


  void printSerialData(String text)
{
  const unsigned long timeout = 2000ul;
  unsigned long startChrono = millis();
  String k="";
  while (millis() - startChrono <= timeout) {
    if (mySIM.available()) {
        SerialMonitor.write(mySIM.read());
        
//      if(mySerial.read()){
//         char c = mySerial.read();
//        Serial.print(c);
//           Serial.print(text);
//           Serial.println(" Success");
//           break;
//        }else{
//           Serial.print(text);
//           Serial.println(" Error");
//           break;
//          
//          }
      //Serial.write(mySerial.read());
     
      startChrono = millis(); // reset the timeOut
    }
  }
  oled.println(text);}

  
  void displaylogo( unsigned char path[]){
    byte r = 0; // Start row
  byte c = 0 ; // Start col
  int a = 0; // Position in array - Don't change - an array larger than 256 will need to use "int = a"
  for (byte b = 0; b < 8; b++) { // I'm expecting to occupy all the 4 rows of the display
    oled.setCursor (c,(r+b)); 
    for (byte i = 0; i < 128; i++) { // since I need to occupy all the 4 rows of the display, I divided the number of elements of the logo array (512) by 4. This is why I got 128.
      oled.ssd1306WriteRam(pgm_read_byte(&path[a]));
      a++;
    }  
  }
  
  }

  
void printGPSInfo()
{


  oled.print("1)Lat: "); oled.println(tinyGPS.location.lat(), 6);
  oled.print("2)Long: "); oled.println(tinyGPS.location.lng(), 6);
  oled.print("3)Date: "); printDate();
  oled.print("4)Time: "); printTime();
  oled.print("4)Speed: "); oled.print(tinyGPS.speed.kmph());oled.println(" kmph");
  oled.print("5)Satellites: "); oled.println(tinyGPS.satellites.value());
  oled.print("6)Sending Data In:"); oled.println(30 - int((millis() - previous)/1000.0));
}

static void smartDelay(unsigned long ms)
{
  unsigned long start = millis();
  do
  {

    while (gpsPort.available())
      tinyGPS.encode(gpsPort.read());
  } while (millis() - start < ms);
}


//For Displaying the data
void printDate()
{
  

  oled.print(tinyGPS.date.day());
  oled.print("/");
  oled.print(tinyGPS.date.month());
  oled.print("/");
  oled.println(tinyGPS.date.year());
}

//For Displaying the time
void printTime()
{
 int Year = tinyGPS.date.year();
   byte Month = tinyGPS.date.month();
   byte Day = tinyGPS.date.day();
   byte Hour = tinyGPS.time.hour();
   byte Minute = tinyGPS.time.minute();
   byte Second = tinyGPS.time.second();
    setTime(Hour, Minute, Second, Day, Month, Year);
    adjustTime(5.50 * SECS_PER_HOUR); 
  oled.print(hour());
  oled.print(":");
  if (tinyGPS.time.minute() < 10) oled.print('0');
  oled.print(minute());
  oled.print(":");
  if (tinyGPS.time.second() < 10) oled.print('0');
  oled.println(second());
}

void makeconnection(){
  
  
  
  }


  void readResponse()
{
  responseString = "";
  while(responseString.length() <= 0 || !responseString.endsWith("\n"))
  {
    tryToRead();

    if(millis() - beltTime > maxResponseTime)
    {
      return;
    }
  }
}

/*
 *  Read from SIM serial until we get known response. TODO error handling!
 * */
void waitUntilResponse(String response)
{
  beltTime = millis();
  responseString="";
  String totalResponse = "";
  while(responseString.indexOf(response) < 0 && millis() - beltTime < maxResponseTime)
  {
    readResponse();
    totalResponse = totalResponse + responseString;
    SerialMonitor.println(responseString);
  }

  if(totalResponse.length() <= 0)
  {
    SerialMonitor.println("No response from the module. Check wiring, SIM-card and power!");
    //digitalWrite(ErrorPin, HIGH);
    //delay(30000);
   // exit(0); // No way to recover
  }
  else if (responseString.indexOf(response) < 0)
  {
    SerialMonitor.println("Unexpected response from the module");
    SerialMonitor.println(totalResponse);
//    digitalWrite(ErrorPin, HIGH);
   // delay(30000);
  //  exit(0); // No way to recover
  }
}

/*
 * If we have anything available on the serial, append it to response string
 * */
void tryToRead()
{
  while(mySIM.available())
  {
    char c = mySIM.read();  //gets one byte from serial buffer
    responseString += c; //makes the string readString
  }
}